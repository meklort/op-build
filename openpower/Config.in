## openpower/Config.in
```kconfig
menu "OpenPower"

source "$BR2_EXTERNAL_OP_BUILD_PATH/platform/Config.in"

menu "OpenPower Packages"
if BR2_OPENPOWER_PLATFORM
source "$BR2_EXTERNAL_OP_BUILD_PATH/package/Config.in"
endif
endmenu

menu "Custom Packages"
source "$BR2_EXTERNAL_OP_BUILD_PATH/custom/Config.in"
endmenu

config BR2_NO_BLOBS
    bool "Remove features requiring binary blobs (experimental)"
    default n
    help
      Attempt to build without any binary blobs. This option is not complete and
      may remove necessary functionality, use with caution.

endmenu
```

## openpower/package/capp-ucode/Config.in
```kconfig
config BR2_PACKAGE_CAPP_UCODE
        bool "capp_capp"
        default y if (BR2_OPENPOWER_PLATFORM)
        depends on !BR2_NO_BLOBS
        help
            Microcode for CAPP hardware

config BR2_CAPP_UCODE_BIN_FILENAME
        string "Name of CAPP UCODE image file"
        depends on !BR2_NO_BLOBS
        help
            String used to define name of the CAPP UCODE binary image file
```
